## boards/arm/at_surf_f437/Kconfig.board
```kconfig
# Copyright (c) 2022, YuLong Yao <feilongphone@gmail.com>
# SPDX-License-Identifier: Apache-2.0

config BOARD_AT32F437_SURF
	bool "Artery AT-SURF-F437 Kit"
	depends on SOC_AT32F437
```

## boards/arm/at_surf_f437/Kconfig.defconfig
```kconfig
# Copyright (c) 2022 YuLong Yao <feilongphone@gmail.com>
# SPDX-License-Identifier: Apache-2.0

if BOARD_AT32F437_SURF

config BOARD
	default "at32f437_surf"

endif   # BOARD_AT32F437_SURF
```

## boards/arm/at_surf_f437/at_surf_f437_defconfig
```kconfig
# Copyright (c) 2022, YuLong Yao <feilongphone@gmail.com>
# SPDX-License-Identifier: Apache-2.0

CONFIG_SOC_SERIES_AT32F43X=y
CONFIG_SOC_AT32F437=y
CONFIG_BOARD_AT32F437_SURF=y

CONFIG_AT32_HXTAL_8MHZ=y
CONFIG_CORTEX_M_SYSTICK=y

CONFIG_CONSOLE=y
CONFIG_UART_CONSOLE=y
CONFIG_SERIAL=y

CONFIG_CLOCK_CONTROL=y

#CONFIG_DEBUG_OPTIMIZATIONS=y
#CONFIG_NO_OPTIMIZATIONS=y
```

## drivers/clock_control/Kconfig.artery
```kconfig
# Copyright (c) 2022 Teslabs Engineering S.L.
# SPDX-License-Identifier: Apache-2.0

config CLOCK_CONTROL_ARTERY
	bool "Atery clock control"
	default y
	depends on DT_HAS_ARTERY_AT32_CCTL_ENABLED
	help
	  Enable driver for Gigadevice Reset Clock Unit (CRM).
```

## drivers/gpio/Kconfig.at32
```kconfig
# Copyright (c) 2022 YuLong Yao <feilongphone@gmail.com>
# SPDX-License-Identifier: Apache-2.0

DT_COMPAT_ARTERY_AT32_GPIO := artery,at32-gpio

config GPIO_AT32
	bool "AT32 GPIO driver"
	depends on (SOC_FAMILY_AT32)
	default $(dt_compat_enabled,$(DT_COMPAT_ARTERY_AT32_GPIO))
	help
	  Enable the AT32 GPIO driver.
```

## drivers/interrupt_controller/Kconfig.at32_exti
```kconfig
# Copyright (c) 2022 YuLong Yao <feilongphone@gmail.com>
# SPDX-License-Identifier: Apache-2.0

DT_COMPAT_AT_AT32_EXTI := artery,at32-exti

config AT32_EXTI
	bool "AT32 Extended Interrupts and Events (EXTI) Controller"
	depends on (SOC_FAMILY_AT32 || SOC_SERIES_AT32F43X)
	default $(dt_compat_enabled,$(DT_COMPAT_AT_AT32_EXTI))
	help
	  Enable the GigaDevice AT32 Extended Interrupts and Events (EXTI)
	  controller driver.
```

## drivers/pinctrl/Kconfig.at32
```kconfig
# Copyright (c) 2022 YuLong Yao <feilongphone@gmail.com>
# SPDX-License-Identifier: Apache-2.0

DT_COMPAT_ARTERY_AT32_PINCTRL_AF := artery,at32-pinctrl-af

config PINCTRL_AT32_AF
	bool "AT32 AF pin controller driver"
	depends on AT32_HAS_AF_PINMUX
	default $(dt_compat_enabled,$(DT_COMPAT_ARTERY_AT32_PINCTRL_AF))
	help
	  GD32 AF pin controller driver. This driver is used by series using the
	  AF pin multiplexing model.
```

## drivers/pwm/Kconfig.at32
```kconfig
# Copyright (c) 2022 YuLong Yao <feilongphone@gmail.com>
# SPDX-License-Identifier: Apache-2.0

config PWM_AT32
	bool "Artery AT32 PWM driver"
	default y
	depends on DT_HAS_ARTERY_AT32_PWM_ENABLED
	select USE_AT32_TMR
	help
	  Enable the ARTERY AT32 PWM driver.
```

## drivers/serial/Kconfig.at32
```kconfig
# Copyright (c) 2022 YuLong Yao <feilongphone@gmail.com>
# SPDX-License-Identifier: Apache-2.0

config USART_AT32
	bool "AT32 serial driver"
	default y
	depends on DT_HAS_ARTERY_AT32_USART_ENABLED
	select SERIAL_HAS_DRIVER
	select SERIAL_SUPPORT_INTERRUPT
	select USE_AT32_USART
	select PINCTRL
	help
	  This option enables the USART driver for AT32 SoC family.
```

## dts/bindings/gpio/artery,at32-gpio.yaml
```yaml
# Copyright (c) 2022 YuLong Yao <feilongphone@gmail.com>
# SPDX-License-Identifier: Apache-2.0

description: AT32 GPIO node

compatible: "artery,at32-gpio"

include: [gpio-controller.yaml, reset-device.yaml, base.yaml]

properties:
  reg:
    required: true

  rcu-periph-clock:
    type: int
    description: Reset Control Unit Peripheral Clock ID
    deprecated: true

  clocks:
    required: true

  # resets:
  #   required: true

  "#gpio-cells":
    const: 2

gpio-cells:
  - pin
  - flags
```

## dts/bindings/misc/artery,at32-syscfg.yaml
```yaml
# Copyright (c) 2022 YuLong Yao <feilongphone@gmail.com>
# SPDX-License-Identifier: Apache-2.0

description: Artery AT32 System Configuration Registers

compatible: "artery,at32-syscfg"

include: base.yaml

properties:
  reg:
    required: true

  clocks:
    required: true
```

## dts/bindings/pwm/artery,at32-pwm.yaml
```yaml
# Copyright (c) 2022 YuLong Yao <feilongphone@gmail.com>
# SPDX-License-Identifier: Apache-2.0

description: Artery AT32 PWM

compatible: "artery,at32-pwm"

include: [base.yaml, pwm-controller.yaml, pinctrl-device.yaml]

properties:
  pinctrl-0:
    required: true

  pinctrl-names:
    required: true

  "#pwm-cells":
    const: 3

pwm-cells:
  - channel
  - period
  - flags
```

## dts/bindings/serial/artery,at32-usart.yaml
```yaml
# Copyright (c) 2022 YuLong Yao <feilongphone@gmail.com>
# SPDX-License-Identifier: Apache-2.0

description: Artery USART

compatible: "artery,at32-usart"

include: [uart-controller.yaml, pinctrl-device.yaml]

properties:
    reg:
      required: true

    interrupts:
      required: true

    rcu-periph-clock:
      type: int
      description: Reset Control Unit Peripheral Clock ID
      required: true
```

## dts/bindings/timer/artery,at32-timer.yaml
```yaml
# Copyright (c) 2022 YuLong Yao <feilongphone@gmail.com>
# SPDX-License-Identifier: Apache-2.0

description: Artery AT32 timer

compatible: "artery,at32-timer"

include: base.yaml

properties:
  reg:
    required: true

  channels:
    type: int
    required: true
    description: Number of timer channels.

  prescaler:
    type: int
    default: 0
    description: Timer prescaler. Defaults to 0 (SoC default).

  is-32bit:
    type: boolean
    description: Indicates if timer has a 32-bit counter.

  is-advanced:
    type: boolean
    description: |
      Indicates if timer has advanced features. Such features include break
      inputs, dead-time insertion, etc.

  rcu-periph-clock:
    type: int
    description: Reset Control Unit Peripheral Clock ID
    required: false
    deprecated: true

  rcu-periph-reset:
    type: int
    description: Reset Control Unit Peripheral Reset ID
    required: false
    deprecated: true

  clocks:
    required: true
```

## modules/hal_artery/Kconfig
```kconfig
# Copyright (c) 2022 YuLong Yao <feilongphone@gmail.com>
# SPDX-License-Identifier: Apache-2.0

config ZEPHYR_HAL_ARTERY_MODULE
	bool

config AT32_HAS_AF_PINMUX
	bool
	help
	  This option should be selected if the series use an AF pinmux model.

config HAS_AT32_HAL
	bool
	select HAS_CMSIS_CORE if SOC_FAMILY_AT32_ARM

if HAS_AT32_HAL

choice AT32_HXTAL_FREQUENCY
	prompt "High speed external oscillator clock frequency"
	default AT32_HXTAL_8MHZ if SOC_SERIES_AT32F43X
	help
	  Define value of high speed crystal oscillator (HEXT_VALUE) in Hz
	  This value sets the frequency of the oscillator.

config AT32_HXTAL_8MHZ
	bool "8MHz"
	depends on SOC_SERIES_AT32F43X
	help
	  Use 8MHz oscillator for HXTAL

config AT32_HXTAL_25MHZ
	bool "25MHz"
	depends on SOC_SERIES_AT32F43X
	help
	  Use 25MHz oscillator for HXTAL

endchoice

config USE_AT32_ACC
	bool
	help
	  Enable AT32 Analog-to-Digital Converter (ADC) HAL module driver

config USE_AT32_ADC
	bool
	help
	  Enable AT32 Analog-to-Digital Converter (ADC) HAL module driver

config USE_AT32_CAN
	bool
	help
	  Enable AT32 Controller Area Network (CAN) HAL module driver

config USE_AT32_CRC
	bool
	help
	  Enable AT32 Cyclic redundancy check calculation unit (CRC) HAL
	  module driver

config USE_AT32_CRM
	bool
	default y
	help
	  Enable AT32 Clock Trim Controller (CTC) HAL module driver

config USE_AT32_DAC
	bool
	help
	  Enable AT32 Digital-to-Analog Converter (DAC) HAL module driver

config USE_AT32_DBG
	bool
	help
	  Enable AT32 Debug (DBG) HAL module driver

config USE_AT32_DMA
	bool
	help
	  Enable AT32 Direct Memory Access controller (DMA) HAL module driver

config USE_AT32_DVP
	bool
	help
	  Enable AT32 Direct Memory Access controller (DMA) HAL module driver

config USE_AT32_EDMA
	bool
	help
	  Enable AT32 External Memory Controller (EXMC) HAL module driver

config USE_AT32_EMAC
	bool
	help
	  Enable AT32 Ethernet (ENET) HAL module driver

config USE_AT32_ERTC
	bool
	help
	  Enable AT32 External Memory Controller (EXMC) HAL module driver

config USE_AT32_EXINT
	bool
	help
	  Enable AT32 Interrupt/Event controller (EXTI) HAL module driver

config USE_AT32_FLASH
	bool
	help
	  Enable AT32 Flash Memory Controller (FMC) HAL module driver

config USE_AT32_GPIO
	bool
	default y
	help
	  Enable AT32 General-purpose and Alternate-Function I/Os
	  (GPIO and AFIO) HAL module driver

config USE_AT32_I2C
	bool
	help
	  Enable AT32 Inter-Integrated Circuit Interface (I2C) HAL module driver

config USE_AT32_MISC
	bool
	help
	  Enable AT32 System Utilities (MISC) HAL module driver

config USE_AT32_PWC
	bool
	help
	  Enable AT32 Power Management Unit (PMU) HAL module driver

config USE_AT32_QSPI
	bool
	help
	  Enable AT32 Serial/Quad Parallel Interface (SQPI) HAL module driver

config USE_AT32_SCFG
	bool
	help
	  Enable AT32 Reset and Clock Unit (RCU) HAL module driver

config USE_AT32_SDIO
	bool
	help
	  Enable AT32 Secure Digital Input/Output interface (SDIO) HAL module
	  driver

config USE_AT32_SPI
	bool
	help
	  Enable AT32 Serial Peripheral Interface(SPI) HAL module driver

config USE_AT32_TMR
	bool
	help
	  Enable AT32 Timer (TIMER) HAL module driver

config USE_AT32_USART
	bool
	help
	  Enable AT32 Universal Synchronous/Asynchronous Receiver/Transmitter
	  (USART) HAL module driver

config USE_AT32_USBD
	bool
	help
	  Enable AT32 Universal Serial Bus full-speed Device interface (USBD)
	  HAL module driver

config USE_AT32_USBFS
	bool
	help
	  Enable AT32 Universal Serial Bus on-the-go Full-Speed (USBFS) HAL
	  module driver

config USE_AT32_USBHS
	bool
	help
	  Enable AT32 Universal Serial Bus High-Speed interface (USBHS) HAL
	  module driver

config USE_AT32_WDT
	bool
	help
	  Enable AT32 Watchdog Timer (WDT) HAL module driver

config USE_AT32_WWDGT
	bool
	help
	  Enable AT32 Window Watchdog Timer (WWDGT) HAL module driver

config USE_AT32_XMC
	bool
	help
	  Enable AT32 Window Watchdog Timer (WWDGT) HAL module driver

endif # HAS_AT32_HAL
```

## soc/arm/artery/Kconfig
```kconfig
# Copyright (c) 2022, YuLong Yao <feilongphone@gmail.com>
# SPDX-License-Identifier: Apache-2.0

config SOC_FAMILY_AT32
	bool
	select HAS_AT32_HAL
	select BUILD_OUTPUT_HEX

config SOC_FAMILY
	string
	default "artery"
	depends on SOC_FAMILY_AT32

config SOC_FAMILY_AT32_ARM
	bool
	select SOC_FAMILY_AT32

if SOC_FAMILY_AT32_ARM

source "soc/arm/artery/*/Kconfig.soc"

endif # SOC_FAMILY_GD32_ARM
```

## soc/arm/artery/Kconfig.defconfig
```kconfig
# Copyright (c) 2022, YuLong Yao <feilongphone@gmail.com>
# SPDX-License-Identifier: Apache-2.0

if SOC_FAMILY_AT32

source "soc/arm/artery/*/Kconfig.defconfig.series"

config PINCTRL
	default n

endif # SOC_FAMILY_AT32
```

## soc/arm/artery/Kconfig.soc
```kconfig
# Copyright (c) 2022, YuLong Yao <feilongphone@gmail.com>
# SPDX-License-Identifier: Apache-2.0

source "soc/arm/artery/*/Kconfig.series"
```

## soc/arm/artery/at32f43x/Kconfig.defconfig.series
```kconfig
# Copyright (c) 2022 YuLong Yao <feilongphone@gmail.com>
# SPDX-License-Identifier: Apache-2.0

if SOC_SERIES_AT32F43X

source "soc/arm/artery/at32f43x/Kconfig.defconfig.at32*"

config SOC_SERIES
	default "at32f43x"

endif # SOC_SERIES_AT32F43X
```

## soc/arm/artery/at32f43x/Kconfig.series
```kconfig
# Copyright (c) 2022 YuLong Yao <feilongphone@gmail.com>
# SPDX-License-Identifier: Apache-2.0

config SOC_SERIES_AT32F43X
	bool "Artery Tech. AT32F43X series Cortex-M4F MCU"
	select ARM
	select CPU_HAS_FPU
	select CPU_CORTEX_M4
	select CPU_CORTEX_M_HAS_SYSTICK
	select CPU_CORTEX_M_HAS_VTOR
	select SOC_FAMILY_AT32_ARM
	select AT32_HAS_AF_PINMUX
	help
	  Enable support for Artery AT32F43X MCU series
```

## soc/arm/artery/at32f43x/Kconfig.soc
```kconfig
# Copyright (c) 2022 YuLong Yao <feilongphone@gmail.com>
# SPDX-License-Identifier: Apache-2.0

choice
	prompt "Artery AT32F43X MCU Selection"
	depends on SOC_SERIES_AT32F43X

	config SOC_AT32F435
		bool "at32f435"

	config SOC_AT32F437
		bool "at32f437"
endchoice
```
